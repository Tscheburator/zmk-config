## config/west.yml
```yaml
# manifest:
#   remotes:
#     - name: remote-name
#       url-base: https://github.com/remote-name
#   projects:
#     # Together with the above defined remote, this refers to a module located at
#     # https://github.com/remote-name/repository-name
#     - name: repository-name
#       remote: remote-name
#       # This points to a west manifest file in the remote module for further imports
#       import: west.yml

manifest:
  remotes:
    - name: zmkfirmware
      url-base: https://github.com/zmkfirmware
    - name: tscheburator
      url-base: https://github.com/Tscheburator
    - name: urob
      url-base: https://github.com/urob
  projects:
    - name: zmk
      remote: zmkfirmware
      revision: v0.2
      import: app/west.yml
    - name: zmk-config
      remote: tscheburator
      revision: main
    - name: zmk-unicode
      remote: urob
      revision: v0.3
  self:
    path: config
```
